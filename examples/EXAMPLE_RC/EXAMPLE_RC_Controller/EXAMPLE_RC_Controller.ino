#include <HANUMAN_32_mini.h>  // เรียกใช้ไลบรารีสำหรับควบคุมบอร์ด Hanuman 32 Mini

int old_x, old_y;  // ประกาศตัวแปรเก็บค่าสัญญาณแกน X และ Y ล่าสุด

void setup() {  // ฟังก์ชันเริ่มต้น ทำงานเพียงครั้งเดียวเมื่อเปิดบอร์ด
  Serial.begin(115200);  // เริ่มต้นการสื่อสาร Serial ที่ความเร็ว 115200 bps
}

void loop() {  // ฟังก์ชันหลัก ทำงานวนซ้ำตลอดเวลา

  int x = pulseIn(23, HIGH);  // อ่านความกว้างพัลส์ RC จาก GPIO23 สำหรับควบคุมการเลี้ยว
  int y = pulseIn(19, HIGH);  // อ่านความกว้างพัลส์ RC จาก GPIO19 สำหรับควบคุมเดินหน้าและถอยหลัง

  if (x == 0) x = 1500;  // หากไม่สามารถอ่านสัญญาณแกน X ได้ ให้กำหนดค่ากลางเป็น 1500
  if (y == 0) y = 1500;  // หากไม่สามารถอ่านสัญญาณแกน Y ได้ ให้กำหนดค่ากลางเป็น 1500

  if (x >= 1450 && x <= 1550) x = 1500;  // กำหนด Dead Zone แกน X เพื่อลดการเลี้ยวเองเมื่อปล่อยคันบังคับ
  if (y >= 1450 && y <= 1550) y = 1500;  // กำหนด Dead Zone แกน Y เพื่อป้องกันมอเตอร์หมุนเอง

  if (x > 800 && x < 2200) old_x = x;  // บันทึกค่า X ล่าสุดเมื่อสัญญาณอยู่ในช่วง 800–2200
  if (y > 800 && y < 2200) old_y = y;  // บันทึกค่า Y ล่าสุดเมื่อสัญญาณอยู่ในช่วง 800–2200

  if (x < 800) x = old_x;  // หากค่า X ต่ำกว่า 800 ให้นำค่า X ล่าสุดกลับมาใช้
  if (y < 800) y = old_y;  // หากค่า Y ต่ำกว่า 800 ให้นำค่า Y ล่าสุดกลับมาใช้

  Serial.print("y : ");  // แสดงข้อความ y :
  Serial.print(y);  // แสดงค่าสัญญาณแกน Y
  Serial.print("   x : ");  // แสดงข้อความ x :
  Serial.print(x);  // แสดงค่าสัญญาณแกน X

  x = constrain(x, 1000, 2000);  // จำกัดค่า X ให้อยู่ระหว่าง 1000–2000
  y = constrain(y, 1000, 2000);  // จำกัดค่า Y ให้อยู่ระหว่าง 1000–2000

  x = map(x, 1000, 2000, -100, 100);  // แปลงค่า X เป็น -100 ถึง 100 สำหรับควบคุมการเลี้ยว
  y = map(y, 1000, 2000, -100, 100);  // แปลงค่า Y เป็น -100 ถึง 100 สำหรับควบคุมเดินหน้าและถอยหลัง

  int motorL = constrain((y + x), -100, 100);  // คำนวณความเร็วมอเตอร์ซ้ายจาก Y + X และจำกัดค่า ±100
  int motorR = constrain((y - x), -100, 100);  // คำนวณความเร็วมอเตอร์ขวาจาก Y - X และจำกัดค่า ±100

  Serial.print("       motorL : ");  // แสดงข้อความ motorL :
  Serial.print(motorL);  // แสดงค่าความเร็วมอเตอร์ซ้าย
  Serial.print("   motorR : ");  // แสดงข้อความ motorR :
  Serial.println(motorR);  // แสดงค่าความเร็วมอเตอร์ขวาและขึ้นบรรทัดใหม่

  fd2(motorL, motorR);  // สั่งมอเตอร์ซ้ายและขวาตามความเร็วที่คำนวณได้
}
